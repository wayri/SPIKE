// SPDX-License-Identifier: Apache-2.0
// Compiled with an inert, validated board_definition.inc generated by Python.
#include "board_library.h"
#include "c_api.h"
#include <cmath>
#include <cstring>
#include <memory>
#include <stdexcept>
#include <string>
#include <vector>

struct Input { const char *name; const char *source; double low; double high; };
struct Output { const char *name; const char *target; bool current; };
enum class FaultParameter { Resistance, Threshold };
struct Fault {
  const char *name; const char *element; FaultParameter parameter;
  double healthy; double low; double high; const char *mechanism;
};
static void kernel_check(spikes_error_code code) {
  if(code!=SPIKES_OK) throw std::runtime_error(spikes_last_error());
}
#include "board_definition.inc"
using Session = std::unique_ptr<spikes_transient_session, decltype(&spikes_transient_session_destroy)>;
using Checkpoint = std::unique_ptr<spikes_transient_checkpoint, decltype(&spikes_transient_checkpoint_destroy)>;
struct spikes_board {
  Session session{nullptr, spikes_transient_session_destroy};
  Checkpoint saved{nullptr, spikes_transient_checkpoint_destroy};
  std::vector<double> fault_values;
  std::vector<double> saved_fault_values;
  std::string error;
};
static thread_local std::string create_error;
template<class F> static int guarded(spikes_board *b, F &&operation) noexcept {
  if(!b) { create_error="Null board"; return SPIKES_BOARD_INVALID; }
  try { b->error.clear(); return operation(); }
  catch(const std::exception &e) { b->error=e.what(); return SPIKES_BOARD_FAILURE; }
  catch(...) { b->error="Unexpected board runtime failure"; return SPIKES_BOARD_FAILURE; }
}
static int invalid(spikes_board *b, const char *message) { b->error=message; return SPIKES_BOARD_INVALID; }
static Session new_session() {
  if(spikes_abi_version()!=SPIKES_ABI_VERSION) throw std::runtime_error("SPIKES engine ABI mismatch");
  spikes_circuit *raw=nullptr;
  kernel_check(spikes_circuit_create(&raw));
  std::unique_ptr<spikes_circuit,decltype(&spikes_circuit_destroy)> circuit(raw,spikes_circuit_destroy);
  populate(circuit.get());
  spikes_transient_options options{};
  kernel_check(spikes_transient_options_init(&options));
  options.time_step_s=MAX_STEP; options.stop_time_s=STOP_TIME; options.max_steps=MAX_STEPS;
  options.initialize_from_operating_point=0;
  options.max_newton_iterations=MAX_NEWTON; options.max_backtracks=MAX_BACKTRACKS;
  options.absolute_tolerance=ABS_TOL; options.relative_tolerance=REL_TOL;
  spikes_transient_session *session=nullptr;
  kernel_check(spikes_transient_session_create(circuit.get(),&options,&session));
  Session result(session,spikes_transient_session_destroy);
  if(spikes_transient_session_status(session)!=SPIKES_SOLVE_CONVERGED)
    throw std::runtime_error(spikes_transient_session_message(session));
  return result;
}
static Checkpoint checkpoint(spikes_board *b) {
  spikes_transient_checkpoint *raw=nullptr;
  kernel_check(spikes_transient_session_checkpoint_create(b->session.get(),&raw));
  return Checkpoint(raw,spikes_transient_checkpoint_destroy);
}
static void set_fault(spikes_board *b, size_t index, double value) {
#if SPIKES_BOARD_HAS_FAULTS
  const auto &fault=FAULTS.at(index);
  auto code=fault.parameter==FaultParameter::Resistance
      ? spikes_transient_session_set_resistance(b->session.get(),fault.element,value)
      : spikes_transient_session_set_mosfet_threshold(b->session.get(),fault.element,value);
  kernel_check(code);
  b->fault_values.at(index)=value;
#else
  (void)b; (void)index; (void)value;
  throw std::runtime_error("This board has no compiled fault sites");
#endif
}
extern "C" {
uint32_t spikes_board_abi_version(void) { return 1; }
uintptr_t spikes_board_engine_identity(void) {
  return reinterpret_cast<uintptr_t>(&spikes_abi_version);
}
int spikes_board_create(spikes_board **out) {
  if(!out) { create_error="Null output pointer"; return SPIKES_BOARD_INVALID; }
  *out=nullptr;
  try {
    auto board=std::make_unique<spikes_board>(); board->session=new_session();
    for(const auto &fault: FAULTS) board->fault_values.push_back(fault.healthy);
    *out=board.release(); create_error.clear(); return SPIKES_BOARD_OK;
  } catch(const std::exception &e) { create_error=e.what(); return SPIKES_BOARD_FAILURE; }
  catch(...) { create_error="Board allocation failed"; return SPIKES_BOARD_FAILURE; }
}
void spikes_board_destroy(spikes_board *b) { delete b; }
const char *spikes_board_error(const spikes_board *b) { return b ? b->error.c_str() : create_error.c_str(); }
int spikes_board_drive(spikes_board *b,const char *pin,double value) {
  return guarded(b,[&] {
    if(!pin || !std::isfinite(value)) return invalid(b,"Drive requires a named pin and finite voltage");
    for(const auto &input: INPUTS) if(std::strcmp(input.name,pin)==0) {
      if(value<input.low || value>input.high) return invalid(b,"Voltage outside declared pin limits");
      kernel_check(spikes_transient_session_set_source_value(b->session.get(),input.source,value));
      return int(SPIKES_BOARD_OK);
    }
    return invalid(b,"Unknown input pin");
  });
}
int spikes_board_step(spikes_board *b,double dt) {
  return guarded(b,[&] {
    double t=0; size_t n=0;
    kernel_check(spikes_transient_session_position(b->session.get(),&t,&n));
    if(!std::isfinite(dt) || dt<MIN_STEP || dt>MAX_STEP || t+dt==t || t+dt>STOP_TIME || n>=MAX_STEPS)
      return invalid(b,"Step exceeds declared time, resolution, or step-count bounds");
    auto before=checkpoint(b);
    uint8_t accepted=0;
    auto code=spikes_transient_session_step(b->session.get(),dt,&accepted);
    if(code!=SPIKES_OK || !accepted || spikes_transient_session_status(b->session.get())!=SPIKES_SOLVE_CONVERGED) {
      std::string error=code!=SPIKES_OK ? spikes_last_error() : spikes_transient_session_message(b->session.get());
      kernel_check(spikes_transient_session_restore(b->session.get(),before.get()));
      b->error=error; return int(SPIKES_BOARD_SOLVER);
    }
    return int(SPIKES_BOARD_OK);
  });
}
int spikes_board_read(spikes_board *b,const char *name,double *out) {
  return guarded(b,[&] {
    if(!name || !out) return invalid(b,"Read requires output name and destination");
    for(const auto &output: OUTPUTS) if(std::strcmp(output.name,name)==0) {
      double value=0;
      kernel_check(output.current ? spikes_transient_session_element_current(b->session.get(),output.target,&value)
                                 : spikes_transient_session_node_voltage(b->session.get(),output.target,&value));
      if(!std::isfinite(value)) throw std::runtime_error("Nonfinite solver output");
      *out=value; return int(SPIKES_BOARD_OK);
    }
    return invalid(b,"Unknown output pin");
  });
}
int spikes_board_position(spikes_board *b,double *t,size_t *n) {
  return guarded(b,[&] { if(!t || !n) return invalid(b,"Position requires destinations");
    kernel_check(spikes_transient_session_position(b->session.get(),t,n)); return int(SPIKES_BOARD_OK); });
}
int spikes_board_residual(spikes_board *b,double *r) {
  return guarded(b,[&] { if(!r) return invalid(b,"Residual requires destination");
    size_t steps=0,factors=0,newton=0;
    kernel_check(spikes_transient_session_diagnostics(b->session.get(),&steps,&factors,&newton,r));
    return int(SPIKES_BOARD_OK); });
}
int spikes_board_save(spikes_board *b) {
  return guarded(b,[&] { b->saved=checkpoint(b); b->saved_fault_values=b->fault_values;
    return int(SPIKES_BOARD_OK); });
}
int spikes_board_restore(spikes_board *b) {
  return guarded(b,[&] { if(!b->saved) return invalid(b,"No checkpoint saved");
    kernel_check(spikes_transient_session_restore(b->session.get(),b->saved.get()));
    b->fault_values=b->saved_fault_values; return int(SPIKES_BOARD_OK); });
}
int spikes_board_reset(spikes_board *b) {
  return guarded(b,[&] { auto fresh=new_session(); b->session=std::move(fresh); b->saved.reset();
    b->saved_fault_values.clear(); b->fault_values.clear();
    for(const auto &fault: FAULTS) b->fault_values.push_back(fault.healthy);
    return int(SPIKES_BOARD_OK); });
}
uint32_t spikes_board_fault_api_version(void) { return 1; }
size_t spikes_board_fault_count(void) { return FAULTS.size(); }
int spikes_board_fault_descriptor_at(size_t index, spikes_board_fault_descriptor *out) {
  if(!out || index>=FAULTS.size()) { create_error="Invalid fault descriptor index"; return SPIKES_BOARD_INVALID; }
  const auto &fault=FAULTS[index];
  *out={fault.name,fault.element,
        fault.parameter==FaultParameter::Resistance ? "resistance_ohm" : "threshold_voltage_v",
        fault.healthy,fault.low,fault.high,fault.mechanism};
  create_error.clear(); return SPIKES_BOARD_OK;
}
int spikes_board_inject_fault(spikes_board *b,const char *name,double value) {
  return guarded(b,[&] {
    if(!name || !std::isfinite(value)) return invalid(b,"Fault requires a name and finite value");
    for(size_t i=0;i<FAULTS.size();++i) if(std::strcmp(FAULTS[i].name,name)==0) {
      if(value<FAULTS[i].low || value>FAULTS[i].high)
        return invalid(b,"Fault value outside declared site limits");
      set_fault(b,i,value); return int(SPIKES_BOARD_OK);
    }
    return invalid(b,"Unknown fault site");
  });
}
int spikes_board_clear_fault(spikes_board *b,const char *name) {
  return guarded(b,[&] {
    if(!name) return invalid(b,"Fault requires a name");
    for(size_t i=0;i<FAULTS.size();++i) if(std::strcmp(FAULTS[i].name,name)==0) {
      set_fault(b,i,FAULTS[i].healthy); return int(SPIKES_BOARD_OK);
    }
    return invalid(b,"Unknown fault site");
  });
}
int spikes_board_clear_all_faults(spikes_board *b) {
  return guarded(b,[&] {
    auto before=checkpoint(b); auto values=b->fault_values;
    try { for(size_t i=0;i<FAULTS.size();++i) set_fault(b,i,FAULTS[i].healthy); }
    catch(...) { kernel_check(spikes_transient_session_restore(b->session.get(),before.get()));
      b->fault_values=std::move(values); throw; }
    return int(SPIKES_BOARD_OK);
  });
}
}
